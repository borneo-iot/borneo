## fw/components/borneo-core/Kconfig
```kconfig
menu "Borneo Core"
    menu "Board Information"

        config BORNEO_PRODUCT_ID
            string "Borneo Product ID"
            default "$BORNEO_PRODUCT_ID"

        config BORNEO_BOARD_ID
            string "Borneo board ID"
            default "$BORNEO_BOARD"

        config BORNEO_BOARD_NAME
            string "Borneo board name"

        config BORNEO_DEVICE_NAME_DEFAULT
            string "Borneo device's default name"

        config BORNEO_DEVICE_COMPATIBLE
            string "Borneo device compatible string"

        config BORNEO_DEVICE_CATEGORY
            string "Borneo Device Category"

        config BORNEO_HW_VER
            string "Borneo hardware version"

        config BORNEO_MANUF_DEFAULT
            string "Borneo manufacturer default value"
            default "BST"

        config BORNEO_EDITION_CE
            bool "Is open-source edition"
            default y

        choice
            prompt "Select product mode"

            config BORNEO_PRODUCT_MODE_STANDALONE
                bool "Standalone Controller"

            config BORNEO_PRODUCT_MODE_FULL
                bool "Proprietary Product"

            config BORNEO_PRODUCT_MODE_OEM
                bool "OEM / Custom"
        endchoice

    endmenu

    menu "Network Provisioning"
        choice
            prompt "Provisioning Method"
            default BORNEO_PROV_METHOD_SC

            config BORNEO_PROV_METHOD_SC
                bool "SmartConfig (ESPTouch)"

            config BORNEO_PROV_METHOD_NP
                bool "Espressif Network Provisioning"
                depends on SOC_BT_SUPPORTED && BT_ENABLED && BT_NIMBLE_ENABLED
        endchoice
    endmenu

    menu "ADC settings"
        config BORNEO_ADC_ENABLED
            bool "ADC enabled"
            default y

        config BORNEO_ADC_CH0_ENABLED
            bool "ADC1 Channel 0 enabled"
            default n
            depends on BORNEO_ADC_ENABLED

        config BORNEO_ADC_CH1_ENABLED
            bool "ADC1 Channel 1 enabled"
            default n
            depends on BORNEO_ADC_ENABLED

        config BORNEO_ADC_CH2_ENABLED
            bool "ADC1 Channel 2 enabled"
            default n
            depends on BORNEO_ADC_ENABLED

        config BORNEO_ADC_CH3_ENABLED
            bool "ADC1 Channel 3 enabled"
            default n
            depends on BORNEO_ADC_ENABLED

        config BORNEO_ADC_CH4_ENABLED
            bool "ADC1 Channel 4 enabled"
            default n
            depends on BORNEO_ADC_ENABLED

        config BORNEO_ADC_CH5_ENABLED
            bool "ADC1 Channel 5 enabled"
            default n
            depends on BORNEO_ADC_ENABLED

        config BORNEO_ADC_CH6_ENABLED
            bool "ADC1 Channel 6 enabled"
            default n
            depends on BORNEO_ADC_ENABLED

        config BORNEO_ADC_CH7_ENABLED
            bool "ADC1 Channel 7 enabled"
            default n
            depends on BORNEO_ADC_ENABLED
    endmenu


    menu "LED Indicator"
        config BORNEO_INDICATOR_ENABLED
            bool "Indicator enabled"
            default y

        choice
            prompt "Select indicator type"
            default BORNEO_INDICATOR_GPIO_ENABLED

            config BORNEO_INDICATOR_GPIO_ENABLED
                bool "Simple GPIO LED"
                depends on BORNEO_INDICATOR_ENABLED

            config BORNEO_INDICATOR_ADDRESSABLE_ENABLED
                bool "Addressable LED"
                depends on BORNEO_INDICATOR_ENABLED
        endchoice

        config BORNEO_INDICATOR_GPIO
            int "Indicator pin"
            depends on BORNEO_INDICATOR_ENABLED

        config BORNEO_INDICATOR_ADDRESSABLE_BRIGHTNESS
            hex "Indicator brightness (0x01-0xFF)"
            range 0x1 0xFF
            default 0x3C
            depends on BORNEO_INDICATOR_ADDRESSABLE_ENABLED
    endmenu

    menu "OTA"
        config BORNEO_OTA_FIRMWARE_UPGRADE_URL
            string "OTA firmware upgrade URL"
    endmenu

    menu "Power Supply Voltage Measurement"
        config BORNEO_MEAS_VOLTAGE_SUPPORT
            bool "Power supply voltage measurement enabled"
            default n

        config BORNEO_MEAS_VOLTAGE_ADC_CHANNEL
            int "Power supply voltage ADC channel"
            depends on BORNEO_MEAS_VOLTAGE_SUPPORT

        config BORNEO_MEAS_VOLTAGE_FACTOR
            int "Power supply ADC voltage attenuation coefficient in μV"
            depends on BORNEO_MEAS_VOLTAGE_SUPPORT
            default 15242
    endmenu

    menu "SNTP Configuration"
        config BORNEO_SNTP_SERVER
            string "SNTP Server Address"
            default "pool.ntp.org"
    endmenu


endmenu
```

## fw/lyfi/main/Kconfig.projbuild
```kconfig
menu "Borneo LyFi"
    menu "Power measursment"
        config LYFI_POWER_MEAS_ENABLED
            bool "LED Power measurement enabled"
            default n

        config LYFI_POWER_MEAS_VOLTAGE_ENABLED
            bool "LED Power voltage measurement enabled"
            depends on LYFI_POWER_MEAS_ENABLED
            default y if LYFI_POWER_MEAS_ENABLED
            default n

        config LYFI_POWER_MEAS_CURRENT_ENABLED
            bool "LED Power current measurement enabled"
            depends on LYFI_POWER_MEAS_ENABLED
            default y if LYFI_POWER_MEAS_ENABLED
            default n

        config LYFI_POWER_MEAS_ADC_UNIT
            int "LED Power measurement ADC unit" if LYFI_POWER_MEAS_ENABLED
            depends on LYFI_POWER_MEAS_ENABLED

        config LYFI_POWER_MEAS_ADC_CHANNEL
            int "LED Power measurement ADC channel" if LYFI_POWER_MEAS_ENABLED
            depends on LYFI_POWER_MEAS_ENABLED
    endmenu

    menu "LED PWM settings"
        config LYFI_DIMMING_TIMEOUT
            int "DIMMING mode timeout (seconds)"
            default 900
            range 0 3600
    endmenu

    menu "LED channels"
        config LYFI_LED_CHANNEL_COUNT
            int "LED physical channel count"
            range 1 10

        config LYFI_LED_CH0_GPIO
            int "GPIO for LED channel 0"
            default -1

        config LYFI_LED_CH1_GPIO
            int "GPIO for LED channel 1"
            default -1

        config LYFI_LED_CH2_GPIO
            int "GPIO for LED channel 2"
            default -1

        config LYFI_LED_CH3_GPIO
            int "GPIO for LED channel 3"
            default -1

        config LYFI_LED_CH4_GPIO
            int "GPIO for LED channel 4"
            default -1

        config LYFI_LED_CH5_GPIO
            int "GPIO for LED channel 5"
            default -1

        config LYFI_LED_CH6_GPIO
            int "GPIO for LED channel 6"
            default -1

        config LYFI_LED_CH7_GPIO
            int "GPIO for LED channel 7"
            default -1

        config LYFI_LED_CH8_GPIO
            int "GPIO for LED channel 8"
            default -1

        config LYFI_LED_CH9_GPIO
            int "GPIO for LED channel 9"
            default -1


    endmenu

    menu "NTC settings"
        config LYFI_NTC_SUPPORT
            bool "NTC enabled"
            depends on BORNEO_ADC_ENABLED
            default n

        config LYFI_NTC_ADC_CHANNEL
            int "NTC ADC channel"
            depends on LYFI_NTC_SUPPORT

        choice
            prompt "NTC Pull-up resistor option"
            default LYFI_NTC_PU_4K7
            depends on LYFI_NTC_SUPPORT

            config LYFI_NTC_PU_10K
                bool "10k pull-up resistor with 3.3V"

            config LYFI_NTC_PU_4K7
                bool "4.7k pull-up resistor with 2.5V"
        endchoice
    endmenu

    menu "Fan"
        config LYFI_FAN_CTRL_SUPPORT
            bool "The controlling method of fan speed"
            default y

        config LYFI_FAN_CTRL_PWM_SUPPORT
            bool "PWM fan support"
            default y
            depends on LYFI_FAN_CTRL_SUPPORT

        choice
            prompt "PWM fan device"
            default LYFI_FAN_CTRL_PWM_DEVICE_RMTPWM
            depends on LYFI_FAN_CTRL_SUPPORT

            config LYFI_FAN_CTRL_PWM_DEVICE_RMTPWM
                bool "Using RMT as the PWM device"
                depends on LYFI_FAN_CTRL_PWM_SUPPORT

            config LYFI_FAN_CTRL_PWM_DEVICE_MCPWM
                bool "Using MCPWM as the PWM device"
                depends on LYFI_FAN_CTRL_PWM_SUPPORT && IDF_TARGET_ESP32
        endchoice

        config LYFI_FAN_CTRL_PWM_GPIO
            int "The GPIO number for PWM fan"
            depends on LYFI_FAN_CTRL_PWM_SUPPORT

        config LYFI_FAN_CTRL_VREG_SUPPORT
            bool "PWM fan internal voltage regulator support"
            default y
            depends on LYFI_FAN_CTRL_SUPPORT

        choice
            prompt "Internal regulator device"
            default LYFI_FAN_CTRL_VREG_DEVICE_RMTPWM
            depends on LYFI_FAN_CTRL_VREG_SUPPORT

            config LYFI_FAN_CTRL_VREG_DEVICE_RMTPWM
                bool "Using RMT-PWM as the internal regulator DAC device"
                depends on LYFI_FAN_CTRL_VREG_SUPPORT

            config LYFI_FAN_CTRL_VREG_DEVICE_DAC
                bool "Using DAC as the internal regulator DAC device"
                depends on LYFI_FAN_CTRL_VREG_SUPPORT && IDF_TARGET_ESP32

            config LYFI_FAN_CTRL_VREG_DEVICE_MCPWM
                bool "Using DAC as the internal regulator MCPWM device"
                depends on LYFI_FAN_CTRL_VREG_SUPPORT && IDF_TARGET_ESP32
        endchoice

        config LYFI_FAN_CTRL_VREG_GPIO
            int "The Output GPIO for the internal voltage regulator"
            depends on LYFI_FAN_CTRL_VREG_SUPPORT && (LYFI_FAN_CTRL_VREG_DEVICE_RMTPWM || LYFI_FAN_CTRL_VREG_DEVICE_MCPWM)

        config LYFI_FAN_CTRL_VREG_DUTY_MIN
            int "The Minimum Duty for the internal voltage regulator"
            depends on LYFI_FAN_CTRL_VREG_SUPPORT

        config LYFI_FAN_CTRL_VREG_DUTY_MAX
            int "The Maximum Duty for the internal voltage regulator"
            depends on LYFI_FAN_CTRL_VREG_SUPPORT

        config LYFI_FAN_CTRL_VREG_DAC_CHANNEL
            int "DAC Channel for DAC"
            depends on LYFI_FAN_CTRL_VREG_SUPPORT && LYFI_FAN_CTRL_VREG_DEVICE_DAC

        config LYFI_FAN_CTRL_SHUTDOWN_ENABLED
            bool "Enable The Shutdown Pin for The Power of Fan"
            depends on LYFI_FAN_CTRL_SUPPORT
            default n

        config LYFI_FAN_CTRL_SHUTDOWN_GPIO
            int "The GPIO Number of the Shutdown Pin"
            depends on LYFI_FAN_CTRL_SHUTDOWN_ENABLED
    endmenu

    menu "Thermal Management"
        config LYFI_THERMAL_ENABLED
            bool "Enable The Thermal Management Sub-system"
            default y
            depends on LYFI_FAN_CTRL_SUPPORT || LYFI_NTC_SUPPORT

        choice
            prompt "Default Fan mode"
            default LYFI_THERMAL_FAN_MODE_PID
            depends on LYFI_THERMAL_ENABLED

            config LYFI_THERMAL_FAN_MODE_PID
                bool "Using PID adaptive algorithm"
                depends on LYFI_THERMAL_ENABLED && LYFI_FAN_CTRL_SUPPORT && LYFI_NTC_SUPPORT

            config LYFI_THERMAL_FAN_MODE_MANUAL
                bool "Manual fan setting"
                depends on LYFI_THERMAL_ENABLED
        endchoice

        config LYFI_THERMAL_FAN_MODE_DEFAULT
            int
            depends on (LYFI_THERMAL_FAN_MODE_PID || LYFI_THERMAL_FAN_MODE_MANUAL) && LYFI_THERMAL_ENABLED

            default 0 if LYFI_THERMAL_FAN_MODE_MANUAL
            default 1 if LYFI_THERMAL_FAN_MODE_PID

    endmenu

    menu "Press Button"
        config LYFI_PRESS_BUTTON_ENABLED
            bool "Enable the press button support"
            default n
        config LYFI_PRESS_BUTTON_GPIO
            int "Press button GPIO number"
            depends on LYFI_PRESS_BUTTON_ENABLED
            default 9
    endmenu

    menu "Protection"
        config LYFI_PROTECTION_ENABLED
            bool "Enable the protection feature"
            depends on  LYFI_NTC_SUPPORT || (LYFI_MEAS_CURRENT_SUPPORT && BORNEO_MEAS_VOLTAGE_SUPPORT)
            default y

        config LYFI_PROTECTION_OVERHEATED_SUPPORT
            bool "Enable the over-power protection"
            default y
            depends on  LYFI_PROTECTION_ENABLED && LYFI_NTC_SUPPORT

        config LYFI_PROTECTION_OVERPOWER_SUPPORT
            bool "Enable the over-power protection"
            default n
            depends on  LYFI_PROTECTION_ENABLED && LYFI_MEAS_CURRENT_SUPPORT && BORNEO_MEAS_VOLTAGE_SUPPORT

        config LYFI_PROTECTION_OVER_POWER_DEFAULT_VALUE
            int "Over-power protection default value"
            depends on LYFI_PROTECTION_OVERPOWER_SUPPORT
    endmenu

    menu "LED Current Measurement"
        config LYFI_MEAS_CURRENT_SUPPORT
            bool "Power supply current measurement enabled"
            default n

        config LYFI_MEAS_CURRENT_ADC_CHANNEL
            int "Power supply current ADC channel"
            depends on LYFI_MEAS_CURRENT_SUPPORT

        config LYFI_MEAS_CURRENT_FACTOR
            int "Power supply current ADC factor in mV/A"
            depends on LYFI_MEAS_CURRENT_SUPPORT
            default 235

        config LYFI_MEAS_CURRENT_OFFSET
            int "Power supply current ADC offset in mV"
            depends on LYFI_MEAS_CURRENT_SUPPORT
            default 0
    endmenu


endmenu
```
