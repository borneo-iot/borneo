## fw/components/drvfx/Kconfig
```kconfig
menu "Drvfx Configuration"

    menu "Drivers"
        rsource "./drivers/i2c/Kconfig"
        rsource "./drivers/spi/Kconfig"
        rsource "./drivers/rtc/Kconfig"
    endmenu

endmenu
```

## fw/components/drvfx/drivers/i2c/Kconfig
```kconfig
menu "I2C"
    config DRVFX_I2C_IDF
        bool "Enable ESP-IDF I2C controller driver"

    config DRVFX_I2C0_NAME
        string "I2C controller device name"
        default "i2c0"
        depends on DRVFX_I2C_IDF

    config DRVFX_I2C0_PORT
        int "I2C controller port"
        default 0
        depends on DRVFX_I2C_IDF

    config DRVFX_I2C0_SDA_GPIO
        int "I2C SDA GPIO number"
        depends on DRVFX_I2C_IDF

    config DRVFX_I2C0_SCL_GPIO
        int "I2C SCL GPIO number"
        depends on DRVFX_I2C_IDF

    config DRVFX_I2C0_FREQ_HZ
        int "I2C clock frequency (Hz)"
        default 100000
        depends on DRVFX_I2C_IDF

    config DRVFX_I2C0_PULLUP
        bool "Enable internal pull-ups"
        default y
        depends on DRVFX_I2C_IDF
endmenu
```

## fw/components/drvfx/drivers/rtc/Kconfig
```kconfig
menu "RTC (Real-Time Clock)"
    choice
        prompt "RTC device"
        default DRIVER_RTC_NONE

        config DRIVER_RTC_NONE
            bool "No RTC"

        config DRIVER_RTC_IDF
            bool "SoC internal RTC"

        config DRIVER_RTC_DS1302
            bool "DS1302"

        config DRIVER_RTC_PCF8563
            bool "PCF8563"
            depends on DRVFX_I2C_IDF
    endchoice

    config DRIVER_RTC_DS1302_CE_GPIO
        int "DS1302 CE GPIO number"
        depends on DRIVER_RTC_DS1302

    config DRIVER_RTC_DS1302_IO_GPIO
        int "DS1302 I/O GPIO number"
        depends on DRIVER_RTC_DS1302

    config DRIVER_RTC_DS1302_SCLK_GPIO
        int "DS1302 SCLK GPIO number"
        depends on DRIVER_RTC_DS1302

    config DRIVER_RTC_DS1302_RST_GPIO
        int "DS1302 RST GPIO number"
        depends on DRIVER_RTC_DS1302

    config DRIVER_RTC_PCF8563_ADDR
        hex "The I2C address of PCF8563"
        default 0x51
        depends on DRIVER_RTC_PCF8563

    config DRIVER_RTC_PCF8563_BUS_NAME
        string "PCF8563 bus device name"
        default "i2c0"
        depends on DRIVER_RTC_PCF8563

    config DRIVER_RTC_PCF8563_TIMEOUT_MS
        int "PCF8563 transaction timeout (ms)"
        default 1000
        depends on DRIVER_RTC_PCF8563

endmenu
```

## fw/components/drvfx/drivers/spi/Kconfig
```kconfig
menu "SPI"
    config DRVFX_SPI_IDF
        bool "Enable ESP-IDF SPI controller driver"

    config DRVFX_SPI0_NAME
        string "SPI controller device name"
        default "spi0"
        depends on DRVFX_SPI_IDF

    config DRVFX_SPI0_HOST
        int "SPI host id"
        default 2
        depends on DRVFX_SPI_IDF

    config DRVFX_SPI0_MOSI_GPIO
        int "SPI MOSI GPIO number"
        depends on DRVFX_SPI_IDF

    config DRVFX_SPI0_MISO_GPIO
        int "SPI MISO GPIO number"
        depends on DRVFX_SPI_IDF

    config DRVFX_SPI0_SCLK_GPIO
        int "SPI SCLK GPIO number"
        depends on DRVFX_SPI_IDF

    config DRVFX_SPI0_MAX_TRANSFER_SZ
        int "SPI max transfer size"
        default 64
        depends on DRVFX_SPI_IDF
endmenu
```
